## boards/shields/nice_oled_common/Kconfig.defconfig
```kconfig
# Copyright (c) 2024 The ZMK Contributors
# SPDX-License-Identifier: MIT
# Common Kconfig for all nice_oled shields

### GENERAL CONFIG START {{{
config NICE_CUSTOM_ON
    bool "Enable nice custom widget compatibility"
    default n

config NICE_OLED_ON
    bool "Enable nice oled widget compatibility"
    default y if SHIELD_NICE_OLED
    default n

config NICE_EPAPER_ON
    bool "Enable nice view widget compatibility"
    default y if SHIELD_NICE_EPAPER
    default n

config NICE_OLED_CUSTOM_CANVAS_WIDTH
    int "Custom Canvas Width"
    default 32 if SHIELD_NICE_OLED
    default 68 if SHIELD_NICE_EPAPER
    default 68 if SHIELD_NICE_CUSTOM
    default 68

config NICE_OLED_CUSTOM_CANVAS_HEIGHT
    int "Custom Canvas Height"
    default 128 if SHIELD_NICE_OLED
    default 160 if SHIELD_NICE_EPAPER
    default 160 if SHIELD_NICE_CUSTOM
    default 160

config LV_Z_VDB_SIZE
    default 64 if NICE_OLED_ON
    default 100 if NICE_EPAPER_ON
    default 100 if NICE_CUSTOM_ON

config LV_DPI_DEF
    default 148 if NICE_OLED_ON
    default 161 if NICE_EPAPER_ON
    default 161 if NICE_CUSTOM_ON

config LV_Z_BITS_PER_PIXEL
    default 1

choice LV_COLOR_DEPTH
    default LV_COLOR_DEPTH_1
endchoice

choice ZMK_DISPLAY_WORK_QUEUE
    default ZMK_DISPLAY_WORK_QUEUE_DEDICATED
endchoice

choice ZMK_DISPLAY_STATUS_SCREEN
    default ZMK_DISPLAY_STATUS_SCREEN_CUSTOM
endchoice

config LV_Z_MEM_POOL_SIZE
    default 8192

config ZMK_DISPLAY_DEDICATED_THREAD_STACK_SIZE
    int "zmk display dedicated thread stack size"
    default 3072 if NICE_OLED_WIDGET_RAW_HID
    default 2560

config ZMK_DISPLAY_DEDICATED_THREAD_PRIORITY
    int "zmk display dedicated thread priority"
    default 5

config ZMK_DISPLAY_STATUS_SCREEN_CUSTOM
    imply NICE_OLED_WIDGET_STATUS

config NICE_OLED_WIDGET_STATUS
    bool "Custom nice oled status widget"
    default y
    select LV_USE_LABEL
    select LV_USE_IMG
    select LV_USE_CANVAS
    select LV_USE_ANIMIMG
    select LV_USE_ANIMATION

config NICE_OLED_WIDGET_INVERTED
    bool "Invert display colors"

### GENERAL CONFIG END  }}}
### WIDGET ON CENTRAL AND PERIPHERAL START {{{
config NICE_OLED_WIDGET_OUTPUT_BACKGROUND
    bool "Enable output background on central and peripheral"
    default n if NICE_OLED_ON
    default y if NICE_EPAPER_ON
    default y if NICE_CUSTOM_ON

config NICE_OLED_SHOW_SLEEP_ART_ON_IDLE
    bool "whether the sleep art should be shown on idle"
    default n

config NICE_OLED_SHOW_SLEEP_ART_ON_SLEEP
    bool "whether the sleep art should be shown on idle"
    default n

## ANIMATION ON CENTRAL AND PERIPHERAL END }}}
### WIDGET ON PERIPHERAL START {{{
### SMART_BATTERY {{{
config NICE_OLED_WIDGET_ANIMATION_PERIPHERAL_SMART_BATTERY
    bool "Enable animation on peripheral"
    default n
##}}}
### NICE_OLED_WIDGET_ANIMATION_PERIPHERAL_WPM {{{
config NICE_OLED_WIDGET_ANIMATION_PERIPHERAL_WPM
    bool "Enable PERIPHERAL WPM widget compatibility"
    default n

if NICE_OLED_WIDGET_ANIMATION_PERIPHERAL_WPM

config NICE_OLED_WIDGET_STATUS
    select ZMK_WPM

endif
##}}}
### NICE_OLED_WIDGET_ANIMATION_PERIPHERAL || NICE_OLED_WIDGET_STATIC_IMAGE_PERIPHERAL {{{
config NICE_OLED_WIDGET_ANIMATION_PERIPHERAL
    bool "Enable animation on peripheral"
    default y

config NICE_OLED_WIDGET_STATIC_IMAGE_PERIPHERAL
    bool "Enable static image on peripheral"
    default y if !NICE_OLED_WIDGET_ANIMATION_PERIPHERAL

if NICE_OLED_WIDGET_ANIMATION_PERIPHERAL || NICE_OLED_WIDGET_STATIC_IMAGE_PERIPHERAL

if NICE_OLED_WIDGET_ANIMATION_PERIPHERAL
config NICE_OLED_WIDGET_ANIMATION_PERIPHERAL_GEM
    bool "Enable gem animation on peripheral"
    default n

config NICE_OLED_WIDGET_ANIMATION_PERIPHERAL_CAT
    bool "Enable cat animation on peripheral"
    default y

config NICE_OLED_WIDGET_ANIMATION_PERIPHERAL_HEAD
    bool "Enable head animation on peripheral"
    default n

config NICE_OLED_WIDGET_ANIMATION_PERIPHERAL_POKEMON
    bool "Enable pokemon animation on peripheral"
    default n

config NICE_OLED_WIDGET_ANIMATION_PERIPHERAL_SPACEMAN
    bool "Enable spaceman animation on peripheral"
    default n

config NICE_OLED_WIDGET_ANIMATION_PERIPHERAL_MS
    int "Animation length in milliseconds"
    default 10000 if NICE_OLED_WIDGET_ANIMATION_PERIPHERAL_POKEMON
    default 4800 if NICE_OLED_WIDGET_ANIMATION_PERIPHERAL_HEAD
    default 4800 if NICE_OLED_WIDGET_ANIMATION_PERIPHERAL_SPACEMAN
    default 960 if NICE_OLED_WIDGET_ANIMATION_PERIPHERAL_GEM
    default 960 if NICE_OLED_WIDGET_ANIMATION_PERIPHERAL_CAT
endif # NICE_OLED_WIDGET_ANIMATION_PERIPHERAL

if NICE_OLED_WIDGET_STATIC_IMAGE_PERIPHERAL
config NICE_OLED_WIDGET_STATIC_IMAGE_PERIPHERAL_VIM
    bool "Enable static vim on peripheral"
    default n

config NICE_OLED_WIDGET_STATIC_IMAGE_PERIPHERAL_VIP_MARCOS
bool "Enable static vim_marcos on peripheral"
    default n
endif # NICE_OLED_WIDGET_STATIC_IMAGE_PERIPHERAL

endif # NICE_OLED_WIDGET_ANIMATION_PERIPHERAL || NICE_OLED_WIDGET_STATIC_IMAGE_PERIPHERAL

# CONFIG_NICE_OLED_WIDGET_PERIPHERAL
config NICE_OLED_WIDGET_PERIPHERAL
    bool "Enable test widget on peripheral"
    default n
### ONLY FOR PERIPHERAL END }}}
### ANIMATION ON PERIPHERAL END }}}
### WIDGET ON CENTRAL START {{{
if !ZMK_SPLIT || ZMK_SPLIT_ROLE_CENTRAL
### NICE OLED WIDGET WPM {{{

config NICE_OLED_WIDGET_WPM
    bool "Enable Nice OLED WPM Widget"
    default y

if NICE_OLED_WIDGET_WPM

config NICE_OLED_WIDGET_STATUS
    select ZMK_WPM

config NICE_OLED_WIDGET_WPM_NUMBER
    bool "Enable NUMBER for WPM"
    default n

config NICE_OLED_WIDGET_WPM_SPEEDOMETER
    bool "Enable SPEEDOMETER for WPM"
    default n if NICE_OLED_ON
    default n if NICE_EPAPER_ON
    default n if NICE_CUSTOM_ON

config NICE_OLED_WIDGET_WPM_GRAPH
    bool "Enable GRAPH for WPM gauge/chart"
    default n if NICE_OLED_ON
    default n if NICE_EPAPER_ON
    default n if NICE_CUSTOM_ON

if NICE_OLED_WIDGET_WPM_GRAPH || NICE_OLED_WIDGET_WPM_SPEEDOMETER # {{{

config NICE_OLED_WIDGET_WPM_GRAPH_FIXED_RANGE
    bool "Enable fixed range for WPM gauge/chart"
    default y

config NICE_OLED_WIDGET_WPM_GRAPH_FIXED_RANGE_MAX
    int "Fixed range maximum for WPM gauge/chart"
    default 100

endif # NICE_OLED_WIDGET_WPM_GRAPH

##}}}
config NICE_OLED_WIDGET_WPM_LUNA # {{{
    bool "Enable wpm luna"
    default n

if NICE_OLED_WIDGET_WPM_LUNA

config NICE_OLED_WIDGET_WPM_LUNA_ANIMATION_MS
    int "Luna Animation in ms for WPM Widget"
    default 300

endif # NICE_OLED_WIDGET_WPM_LUNA }}}
config NICE_OLED_WIDGET_WPM_BONGO_CAT # {{{
    bool "Enable wpm bongo cat"
    default y

if NICE_OLED_WIDGET_WPM_BONGO_CAT

config NICE_OLED_WIDGET_WPM_BONGO_CAT_ANIMATION_MS
    int "Bongo Cat Animation in ms for WPM Widget"
    default 300

endif # NICE_OLED_WIDGET_WPM_BONGO_CAT }}}
endif # NICE_OLED_WIDGET_WPM }}}
### NICE_OLED_WIDGET_RESPONSIVE {{{
config NICE_OLED_WIDGET_RESPONSIVE
    bool "Enable widget responsive"
    default n

if NICE_OLED_WIDGET_RESPONSIVE

config ZMK_DISPLAY_DEDICATED_THREAD_STACK_SIZE
    default 4096

config ZMK_DISPLAY_DEDICATED_THREAD_PRIORITY
    default 3

config NICE_OLED_WIDGET_RESPONSIVE_BONGO_CAT # {{{
    bool "Enable widget responsive bongo cat"
    default n

endif

##}}}
### NICE OLED WIDGET HID INDICATORS {{{
config NICE_OLED_WIDGET_HID_INDICATORS
    bool "Enable HID indicators"
    default y

if NICE_OLED_WIDGET_HID_INDICATORS

config ZMK_HID_INDICATORS
    bool "Enable HID indicators"
    default y

config NICE_OLED_WIDGET_HID_INDICATORS_LUNA
    bool "Enable HID indicators luna"
    default n

if NICE_OLED_WIDGET_HID_INDICATORS_LUNA

config NICE_OLED_WIDGET_HID_INDICATORS_LUNA_ONLY_CAPSLOCK
    bool "Enable HID indicators luna only on CapsLock"
    default n

config NICE_OLED_WIDGET_HID_INDICATORS_LUNA_ANIMATION_MS
    int "Luna Animation in ms for HID Indicators"
    default 300

endif # NICE_OLED_WIDGET_HID_INDICATORS_LUNA


config NICE_OLED_WIDGET_HID_INDICATORS_BONGO_CAT
    bool "Enable HID indicators bongo cat"
    default n

if NICE_OLED_WIDGET_HID_INDICATORS_BONGO_CAT

config NICE_OLED_WIDGET_HID_INDICATORS_BONGO_CAT_ONLY_CAPSLOCK
    bool "Enable HID indicators bongo cat only on CapsLock"
    default n

config NICE_OLED_WIDGET_HID_INDICATORS_BONGO_CAT_ANIMATION_MS
    int "Luna Animation in ms for HID Indicators bongo cat"
    default 300

endif # NICE_OLED_WIDGET_HID_INDICATORS_BONGO_CAT

endif # NICE_OLED_WIDGET_HID_INDICATORS }}}
### NICE OLED WIDGET RAW HID {{{
config NICE_OLED_WIDGET_RAW_HID
    bool "Enable RAW HID"

if NICE_OLED_WIDGET_RAW_HID

config NICE_OLED_WIDGET_RAW_HID_DRIVER
    bool "Enable Raw HID"
    select LV_FONT_MONTSERRAT_14
    imply USB_DEVICE_HID
    default y if NICE_OLED_WIDGET_RAW_HID

config USB_HID_DEVICE_COUNT
    default 2

config NICE_OLED_WIDGET_RAW_HID_USAGE_PAGE
    hex "Raw HID Usage Page"
    default 0xFF60

config NICE_OLED_WIDGET_RAW_HID_USAGE
    hex "Raw HID Usage"
    default 0x61

config NICE_OLED_WIDGET_RAW_HID_REPORT_SIZE
    int "Raw HID Report Size"
    default 32

config NICE_OLED_WIDGET_RAW_HID_DEVICE
    string "Raw HID Device"
    default HID_1

config NICE_OLED_WIDGET_RAW_HID_LAYOUT
    bool "Show layout"
    default y

config NICE_OLED_WIDGET_RAW_HID_TIME
    bool "Show time"
    default y

config NICE_OLED_WIDGET_RAW_HID_VOLUME
    bool "Show volume"
    default y

config NICE_OLED_WIDGET_RAW_HID_LAYOUT_LIST
    string "Comma-separated layout list"
    default "DE,US,LA,AB"

config NICE_OLED_WIDGET_RAW_HID_WEATHER
    bool "nice!OLED Weather Widget"
    default n

config NICE_OLED_WIDGET_RAW_HID_MEDIA_PLAYER_SPOTIFY_MACOS
    bool "nice!OLED Spotify MacOS Media Player Widget"
    default n

endif # NICE_OLED_WIDGET_RAW_HID }}}
### NICE OLED WIDGET MODIFIERS INDICATORS {{{
config NICE_OLED_WIDGET_MODIFIERS_INDICATORS
    bool "Enable modifiers indicators"
    default y

if NICE_OLED_WIDGET_MODIFIERS_INDICATORS

config NICE_OLED_WIDGET_MODIFIERS_INDICATORS_FIXED
    bool "Enable modifiers indicators fixed"
    default y


if NICE_OLED_WIDGET_MODIFIERS_INDICATORS_FIXED

choice NICE_OLED_WIDGET_MODIFIERS_INDICATORS_FIXED_STYLE
    prompt "Modifiers Style"
    default NICE_OLED_WIDGET_MODIFIERS_INDICATORS_FIXED_SYMBOL

    config NICE_OLED_WIDGET_MODIFIERS_INDICATORS_FIXED_LETTER
        bool "Letter (e.g. C S A G)"

    config NICE_OLED_WIDGET_MODIFIERS_INDICATORS_FIXED_SYMBOL
        bool "Symbol (Icons)"
endchoice

choice NICE_OLED_WIDGET_MODIFIERS_INDICATORS_FIXED_LAYOUT
    prompt "Modifiers Layout"
    default NICE_OLED_WIDGET_MODIFIERS_INDICATORS_FIXED_BOX

    config NICE_OLED_WIDGET_MODIFIERS_INDICATORS_FIXED_HOR
        bool "Horizontal (One Line)"

    config NICE_OLED_WIDGET_MODIFIERS_INDICATORS_FIXED_VER
        bool "Vertical (Stacked)"

    config NICE_OLED_WIDGET_MODIFIERS_INDICATORS_FIXED_BOX
        bool "Box (2x2 Grid)"
endchoice

if NICE_OLED_WIDGET_MODIFIERS_INDICATORS_FIXED_VER

choice NICE_OLED_WIDGET_MODIFIERS_INDICATORS_FIXED_VER_ALIGN
    prompt "Vertical Layout Alignment"
    default NICE_OLED_WIDGET_MODIFIERS_INDICATORS_FIXED_VER_ALIGN_CENTER

    config NICE_OLED_WIDGET_MODIFIERS_INDICATORS_FIXED_VER_ALIGN_LEFT
        bool "Left"

    config NICE_OLED_WIDGET_MODIFIERS_INDICATORS_FIXED_VER_ALIGN_CENTER
        bool "Center"

    config NICE_OLED_WIDGET_MODIFIERS_INDICATORS_FIXED_VER_ALIGN_RIGHT
        bool "Right"
endchoice

endif # NICE_OLED_WIDGET_MODIFIERS_INDICATORS_FIXED_VER

choice NICE_OLED_WIDGET_MODIFIERS_INDICATORS_FIXED_SYMBOL_OS
    prompt "Symbol OS Style"
    default NICE_OLED_WIDGET_MODIFIERS_INDICATORS_FIXED_SYMBOL_MACOS
    depends on NICE_OLED_WIDGET_MODIFIERS_INDICATORS_FIXED_SYMBOL

    config NICE_OLED_WIDGET_MODIFIERS_INDICATORS_FIXED_SYMBOL_MACOS
        bool "macOS (Cmd/Opt symbols)"

    config NICE_OLED_WIDGET_MODIFIERS_INDICATORS_FIXED_SYMBOL_WINDOWS
        bool "Windows (Win/Alt symbols)"
endchoice

config NICE_OLED_WIDGET_MODIFIERS_INDICATORS_LUNA
    bool "Enable modifiers indicators luna"
    default n

if NICE_OLED_WIDGET_MODIFIERS_INDICATORS_LUNA

config NICE_OLED_WIDGET_MODIFIERS_INDICATORS_LUNA_ANIMATION_MS
    int "Luna Animation in ms for Modifiers Indicators"
    default 300

endif # NICE_OLED_WIDGET_MODIFIERS_INDICATORS_LUNA

endif # NICE_OLED_WIDGET_MODIFIERS_INDICATORS_FIXED
endif # NICE_OLED_WIDGET_MODIFIERS_INDICATORS }}}
### NICE OLED WIDGET LAYER {{{
config NICE_OLED_WIDGET_LAYER
    bool "Enable layer widget"
    default y
# }}}
### NICE OLED WIDGET PROFILE {{{
config NICE_OLED_WIDGET_PROFILE_BIG
    bool "Enable show widget profile bigger"
    default y if NICE_EPAPER_ON
    default y if NICE_CUSTOM_ON
    default n
# }}}
### NICE_OLED_WIDGET_CENTRAL_SHOW_BATTERY_PERIPHERAL {{{
config NICE_OLED_WIDGET_CENTRAL_SHOW_BATTERY_PERIPHERAL_ALL
    bool "View all available batteries on the central screen, including the central battery."
    default n

config NICE_OLED_WIDGET_CENTRAL_SHOW_BATTERY_PERIPHERAL_ONLY
    bool "View all peripheral batteries, but not the central battery"
    default n

config NICE_OLED_WIDGET_CENTRAL_SHOW_BATTERY_PERIPHERAL_AND_CENTRAL
    bool "View only 1 peripheral batterie and the central battery"
    default n

##}}}
### ONLY FOR CENTRAL START {{{
config NICE_OLED_WIDGET_CENTRAL
    bool "Enable test widget on central"
    default n
### ONLY FOR CENTRAL END }}}
endif # !ZMK_SPLIT || ZMK_SPLIT_ROLE_CENTRAL
## ANIMATION ON CENTRAL END }}}

### WIDGET POSITION COORDINATES - see shield-specific Kconfig for positions }}}
```
